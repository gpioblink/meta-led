## conf/layer.conf
```bitbake
# We have a conf and classes directory, add to BBPATH
BBPATH .= ":${LAYERDIR}"

# We have recipes-* directories, add to BBFILES
BBFILES += "${LAYERDIR}/recipes-*/*/*.bb \
            ${LAYERDIR}/recipes-*/*/*.bbappend"

BBFILE_COLLECTIONS += "meta-led"
BBFILE_PATTERN_meta-led = "^${LAYERDIR}/"
BBFILE_PRIORITY_meta-led = "6"

LAYERDEPENDS_meta-led = "core"
LAYERSERIES_COMPAT_meta-led = "dunfell"
```
